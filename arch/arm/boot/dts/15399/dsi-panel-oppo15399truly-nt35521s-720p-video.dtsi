/* Copyright (c) 2013, The Linux Foundation. All rights reserved.
 *
 * This program is free software; you can redistribute it and/or modify
 * it under the terms of the GNU General Public License version 2 and
 * only version 2 as published by the Free Software Foundation.
 *
 * This program is distributed in the hope that it will be useful,
 * but WITHOUT ANY WARRANTY; without even the implied warranty of
 * MERCHANTABILITY or FITNESS FOR A PARTICULAR PURPOSE.  See the
 * GNU General Public License for more details.
 */

/*---------------------------------------------------------------------------
 * This file is autogenerated file using gcdb parser. Please do not edit it.
 * Update input XML file to add a new entry or update variable in this file
 * VERSION = "1.0"
 *---------------------------------------------------------------------------*/
&mdss_mdp {
	dsi_oppo15399truly_nt35521s_720p_video: qcom,mdss_dsi_oppo15399truly_nt35521s_720p_video {
		qcom,mdss-dsi-panel-name = "oppo15399truly nt35521s 720p video mode dsi panel";
		qcom,mdss-dsi-panel-manufacture = "TRULY";
		qcom,mdss-dsi-panel-version = "NT35521S";		
		qcom,mdss-dsi-panel-controller = <&mdss_dsi0>;
		qcom,mdss-dsi-panel-type = "dsi_video_mode";
		qcom,mdss-dsi-panel-destination = "display_1";
		qcom,mdss-dsi-panel-framerate = <60>;
		qcom,mdss-dsi-virtual-channel-id = <0>;
		qcom,mdss-dsi-stream = <0>;
		qcom,mdss-dsi-panel-width = <720>;
		qcom,mdss-dsi-panel-height = <1280>;
		qcom,mdss-dsi-h-front-porch = <240>;
		qcom,mdss-dsi-h-back-porch = <230>;
		qcom,mdss-dsi-h-pulse-width = <8>;
		qcom,mdss-dsi-h-sync-skew = <0>;
		qcom,mdss-dsi-v-back-porch = <26>;
		qcom,mdss-dsi-v-front-porch = <26>;
		qcom,mdss-dsi-v-pulse-width = <8>;
		qcom,mdss-dsi-h-left-border = <0>;
		qcom,mdss-dsi-h-right-border = <0>;
		qcom,mdss-dsi-v-top-border = <0>;
		qcom,mdss-dsi-v-bottom-border = <0>;
		qcom,mdss-dsi-bpp = <24>;
		qcom,mdss-dsi-color-order = "rgb_swap_rgb";
		qcom,mdss-dsi-underflow-color = <0xff>;
		qcom,mdss-dsi-border-color = <0>;
		qcom,mdss-dsi-pixel-packing = "tight";
		qcom,mdss-dsi-on-command = [39 01 00 00 00 00 06 F0 55 AA 52 08 00
39 01 00 00 00 00 03 B1 68 21
39 01 00 00 00 00 02 B6 01
39 01 00 00 00 00 05 B8 01 02 08 02
39 01 00 00 00 00 03 BB 11 11
39 01 00 00 00 00 03 BC 00 00
39 01 00 00 00 00 06 F0 55 AA 52 08 01
39 01 00 00 00 00 03 B0 0F 0F
39 01 00 00 00 00 03 B1 0F 0F
39 01 00 00 00 00 03 B3 28 28
39 01 00 00 00 00 03 B4 19 19
39 01 00 00 00 00 03 B5 05 05
39 01 00 00 00 00 03 B9 44 44
39 01 00 00 00 00 03 BA 24 24
39 01 00 00 00 00 03 BC 88 00
39 01 00 00 00 00 03 BD 88 00
39 01 00 00 00 00 02 BE 44
39 01 00 00 00 00 02 C0 0C
39 01 00 00 00 00 02 CA 00
39 01 00 00 00 00 06 F0 55 AA 52 08 02
39 01 00 00 00 00 02 EE 00
39 01 00 00 00 00 11 B0 00 95 00 AA 00 C8 00 E0 00 F5 01 17 01 31 01 60
39 01 00 00 00 00 11 B1 01 84 01 BA 01 E4 02 23 02 52 02 53 02 85 02 BE
39 01 00 00 00 00 11 B2 02 DE 03 0E 03 2E 03 52 03 70 03 91 03 A1 03 B3
39 01 00 00 00 00 05 B3 03 C5 03 D8
39 01 00 00 00 00 11 B4 00 95 00 AA 00 C8 00 E0 00 F5 01 17 01 31 01 60
39 01 00 00 00 00 11 B5 01 84 01 BA 01 E4 02 23 02 52 02 53 02 85 02 BE
39 01 00 00 00 00 11 B6 02 DE 03 0E 03 2E 03 52 03 70 03 91 03 A1 03 B3
39 01 00 00 00 00 05 B7 03 C5 03 D8
39 01 00 00 00 00 11 B8 00 95 00 AA 00 C8 00 E0 00 F5 01 17 01 31 01 60
39 01 00 00 00 00 11 B9 01 84 01 BA 01 E4 02 23 02 52 02 53 02 85 02 BE
39 01 00 00 00 00 11 BA 02 DE 03 0E 03 2E 03 52 03 70 03 91 03 A1 03 B3
39 01 00 00 00 00 05 BB 03 C5 03 D8
39 01 00 00 00 00 11 BC 00 45 00 5B 00 7A 00 94 00 AA 00 CF 00 EB 01 1F
39 01 00 00 00 00 11 BD 01 48 01 88 01 BC 02 0F 02 51 02 53 02 85 02 BE
39 01 00 00 00 00 11 BE 02 DE 03 0E 03 2E 03 52 03 70 03 91 03 A1 03 B3
39 01 00 00 00 00 05 BF 03 C5 03 FC
39 01 00 00 00 00 11 C0 00 45 00 5B 00 7A 00 94 00 AA 00 CF 00 EB 01 1F
39 01 00 00 00 00 11 C1 01 48 01 88 01 BC 02 0F 02 51 02 53 02 85 02 BE
39 01 00 00 00 00 11 C2 02 DE 03 0E 03 2E 03 52 03 70 03 91 03 A1 03 B3
39 01 00 00 00 00 05 C3 03 C5 03 FC
39 01 00 00 00 00 11 C4 00 45 00 5B 00 7A 00 94 00 AA 00 CF 00 EB 01 1F
39 01 00 00 00 00 11 C5 01 48 01 88 01 BC 02 0F 02 51 02 53 02 85 02 BE
39 01 00 00 00 00 11 C6 02 DE 03 0E 03 2E 03 52 03 70 03 91 03 A1 03 B3
39 01 00 00 00 00 05 C7 03 C5 03 FC
39 01 00 00 00 00 06 F0 55 AA 52 08 03
39 01 00 00 00 00 03 B0 20 00
39 01 00 00 00 00 03 B1 20 00
39 01 00 00 00 00 06 B2 04 00 52 01 51
39 01 00 00 00 00 06 B3 04 00 52 01 51
39 01 00 00 00 00 06 B6 04 00 52 01 51
39 01 00 00 00 00 06 B7 04 00 52 01 51
39 01 00 00 00 00 06 BA 44 00 60 01 72
39 01 00 00 00 00 06 BB 44 00 60 01 72
39 01 00 00 00 00 06 BC 53 00 03 00 48
39 01 00 00 00 00 06 BD 53 00 03 00 48
39 01 00 00 00 00 02 C4 40
39 01 00 00 00 00 02 C5 40
39 01 00 00 00 00 06 F0 55 AA 52 08 05
39 01 00 00 00 00 03 B0 17 06
39 01 00 00 00 00 02 B8 00
39 01 00 00 00 00 06 BD 0F 03 03 00 03
39 01 00 00 00 00 03 B1 17 06
39 01 00 00 00 00 02 B9 00
39 01 00 00 00 00 03 B2 17 06
39 01 00 00 00 00 02 BA 00
39 01 00 00 00 00 03 B3 17 06
39 01 00 00 00 00 02 BB 00
39 01 00 00 00 00 03 B4 17 06
39 01 00 00 00 00 03 B5 17 06
39 01 00 00 00 00 03 B6 17 06
39 01 00 00 00 00 03 B7 17 06
39 01 00 00 00 00 02 BC 00
39 01 00 00 00 00 02 E5 06
39 01 00 00 00 00 02 E6 06
39 01 00 00 00 00 02 E7 06
39 01 00 00 00 00 02 E8 06
39 01 00 00 00 00 02 E9 0A
39 01 00 00 00 00 02 EA 06
39 01 00 00 00 00 02 EB 06
39 01 00 00 00 00 02 EC 06
39 01 00 00 00 00 02 ED 30
39 01 00 00 00 00 02 C0 07
39 01 00 00 00 00 02 C1 05
39 01 00 00 00 00 02 C4 82
39 01 00 00 00 00 02 C5 80
39 01 00 00 00 00 03 C8 03 20
39 01 00 00 00 00 03 C9 01 21
39 01 00 00 00 00 03 CA 03 20
39 01 00 00 00 00 03 CB 07 20
39 01 00 00 00 00 0c D1 03 05 00 05 00 00 00 00 00 00 00
39 01 00 00 00 00 0c D2 03 05 00 03 00 00 00 00 00 00 00
39 01 00 00 00 00 0c D3 03 05 04 05 00 00 00 00 00 00 00
39 01 00 00 00 00 0c D4 03 05 04 03 00 00 00 00 00 00 00
39 01 00 00 00 00 06 F0 55 AA 52 08 06
39 01 00 00 00 00 03 B0 2E 2E
39 01 00 00 00 00 03 B1 2E 2E
39 01 00 00 00 00 03 B2 2E 2E
39 01 00 00 00 00 03 B3 2E 09
39 01 00 00 00 00 03 B4 0B 23
39 01 00 00 00 00 03 B5 1D 1F
39 01 00 00 00 00 03 B6 11 17
39 01 00 00 00 00 03 B7 13 19
39 01 00 00 00 00 03 B8 01 03
39 01 00 00 00 00 03 B9 2E 2E
39 01 00 00 00 00 03 BA 2E 2E
39 01 00 00 00 00 03 BB 02 00
39 01 00 00 00 00 03 BC 18 12
39 01 00 00 00 00 03 BD 16 10
39 01 00 00 00 00 03 BE 1E 1C
39 01 00 00 00 00 03 BF 22 0A
39 01 00 00 00 00 03 C0 08 2E
39 01 00 00 00 00 03 C1 2E 2E
39 01 00 00 00 00 03 C2 2E 2E
39 01 00 00 00 00 03 C3 2E 2E
39 01 00 00 00 00 03 E5 25 24
39 01 00 00 00 00 03 C4 2E 2E
39 01 00 00 00 00 03 C5 2E 2E
39 01 00 00 00 00 03 C6 2E 2E
39 01 00 00 00 00 03 C7 2E 02
39 01 00 00 00 00 03 C8 00 24
39 01 00 00 00 00 03 C9 1E 1C
39 01 00 00 00 00 03 CA 18 12
39 01 00 00 00 00 03 CB 16 10
39 01 00 00 00 00 03 CC 0A 08
39 01 00 00 00 00 03 CD 2E 2E
39 01 00 00 00 00 03 CE 2E 2E
39 01 00 00 00 00 03 CF 09 0B
39 01 00 00 00 00 03 D0 11 17
39 01 00 00 00 00 03 D1 13 19
39 01 00 00 00 00 03 D2 1D 1F
39 01 00 00 00 00 03 D3 25 01
39 01 00 00 00 00 03 D4 03 2E
39 01 00 00 00 00 03 D5 2E 2E
39 01 00 00 00 00 03 D6 2E 2E
39 01 00 00 00 00 03 D7 2E 2E
39 01 00 00 00 00 03 E6 22 23
39 01 00 00 00 00 06 D8 00 00 00 00 00
39 01 00 00 00 00 06 D9 00 00 00 00 00
39 01 00 00 00 00 02 E7 00
39 01 00 00 00 00 02 51 FF
39 01 00 00 00 00 02 53 2C
39 01 00 00 00 00 02 55 01 // UI MODE
39 01 00 00 00 00 05 FF AA 55 25 01 
39 01 00 00 00 00 02 6F 16
39 01 00 00 00 00 02 F7 10
39 01 00 00 00 00 05 FF AA 55 25 00
39 01 00 00 00 00 06 FF 55 AA 52 08 04 
39 01 00 00 00 00 04 C2 80 60 00
39 01 00 00 00 00 06 FF 55 AA 52 08 00 
39 01 00 00 00 00 02 C8 80
05 01 00 00 C8 00 02 11 00
05 01 00 00 78 00 02 29 00];
		qcom,mdss-dsi-off-command = [05 01 00 00 32 00 02 28 00
					05 01 00 00 78 00 02 10 00];
		qcom,mdss-dsi-on-command-state = "dsi_lp_mode";
		qcom,mdss-dsi-off-command-state = "dsi_hs_mode";
		qcom,mdss-dsi-cabc-off-command = [15 01 00 00 10 00 02 55 00
										  05 01 00 00 10 00 02 29 00];
		qcom,mdss-dsi-cabc-ui-command = [15 01 00 00 10 00 02 55 01
										 05 01 00 00 10 00 02 29 00];
		qcom,mdss-dsi-cabc-still-image-command = [15 01 00 00 10 00 02 55 02
												  05 01 00 00 10 00 02 29 00];
		qcom,mdss-dsi-cabc-video-command = [15 01 00 00 10 00 02 55 03
											05 01 00 00 10 00 02 29 00];
		qcom,mdss-dsi-panel-status-command = [06 01 00 01 05 00 02 0A 08];
		qcom,mdss-dsi-panel-status-command-state = "dsi_lp_mode";
		qcom,mdss-dsi-panel-status-check-mode = "reg_read";
		qcom,mdss-dsi-panel-status-value = <0x9C>;
		qcom,mdss-dsi-tx-eot-append;		
		qcom,mdss-dsi-h-sync-pulse = <1>;
		qcom,mdss-dsi-lp11-init;
		qcom,mdss-dsi-init-delay-us = <50000>;		
		qcom,mdss-dsi-traffic-mode = "burst_mode";
		qcom,mdss-dsi-lane-map = "lane_map_0123";
		qcom,mdss-dsi-bllp-eof-power-mode;
		qcom,mdss-dsi-bllp-power-mode;
		qcom,mdss-dsi-hfp-power-mode;
		qcom,mdss-dsi-hbp-power-mode;
		qcom,mdss-dsi-hsa-power-mode;
		qcom,mdss-dsi-lane-0-state;
		qcom,mdss-dsi-lane-1-state;
		qcom,mdss-dsi-lane-2-state;
		//qcom,mdss-dsi-lane-3-state;
		qcom,mdss-dsi-panel-timings = [E2 30 20 00 5C 62 24 34 26 03 04 00];
		qcom,mdss-dsi-t-clk-post = <0x04>;
		qcom,mdss-dsi-t-clk-pre = <0x29>;
		qcom,mdss-dsi-bl-min-level = <1>;
		qcom,mdss-dsi-bl-max-level = <255>;
		qcom,mdss-dsi-dma-trigger = "trigger_sw";
		qcom,mdss-dsi-mdp-trigger = <0>;
		qcom,mdss-dsi-bl-pmic-control-type = "bl_ctrl_wled";
		qcom,mdss-dsi-reset-sequence = <1 10>, <0 1>, <1 15>;
		qcom,mdss-pan-physical-width-dimension = <62>;
		qcom,mdss-pan-physical-height-dimension = <110>;
	};
};
