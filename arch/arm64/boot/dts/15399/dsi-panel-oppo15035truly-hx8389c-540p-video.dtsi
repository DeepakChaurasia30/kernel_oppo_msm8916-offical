/* Copyright (c) 2013-2014, The Linux Foundation. All rights reserved.
 *
 * This program is free software; you can redistribute it and/or modify
 * it under the terms of the GNU General Public License version 2 and
 * only version 2 as published by the Free Software Foundation.
 *
 * This program is distributed in the hope that it will be useful,
 * but WITHOUT ANY WARRANTY; without even the implied warranty of
 * MERCHANTABILITY or FITNESS FOR A PARTICULAR PURPOSE.  See the
 * GNU General Public License for more details.
 */

&mdss_mdp {
	dsi_oppo15035truly_hx8389c_540p_video: qcom,mdss_dsi_oppo15035truly_hx8389c_540p_video {
		qcom,mdss-dsi-panel-name = "oppo15035truly hx8389c 540p video mode dsi panel";
		qcom,mdss-dsi-panel-manufacture = "Truly";
		qcom,mdss-dsi-panel-version = "HX8389C";
		qcom,mdss-dsi-panel-controller = <&mdss_dsi0>;
		qcom,mdss-dsi-panel-type = "dsi_video_mode";
		qcom,mdss-dsi-panel-destination = "display_1";
		qcom,mdss-dsi-panel-framerate = <60>;
		qcom,mdss-dsi-virtual-channel-id = <0>;
		qcom,mdss-dsi-stream = <0>;
		qcom,mdss-dsi-panel-width = <540>;
		qcom,mdss-dsi-panel-height = <960>;
		qcom,mdss-dsi-h-front-porch = <50>;
		qcom,mdss-dsi-h-back-porch = <60>;
		qcom,mdss-dsi-h-pulse-width = <8>;
		qcom,mdss-dsi-h-sync-skew = <0>;
		qcom,mdss-dsi-v-back-porch = <9>;
		qcom,mdss-dsi-v-front-porch = <5>;
		qcom,mdss-dsi-v-pulse-width = <2>;
		qcom,mdss-dsi-h-left-border = <0>;
		qcom,mdss-dsi-h-right-border = <0>;
		qcom,mdss-dsi-v-top-border = <0>;
		qcom,mdss-dsi-v-bottom-border = <0>;
		qcom,mdss-dsi-bpp = <24>;
		qcom,mdss-dsi-color-order = <0>;
		qcom,mdss-dsi-underflow-color = <0xff>;
		qcom,mdss-dsi-border-color = <0>;
		qcom,mdss-dsi-on-command = [39 01 00 00 00 00 04 B9 FF 83 89
39 01 00 00 00 00 11 B1 7F 0F 0F 34 34 50 D0 E8 94 80 20 20 F8 AA AA A1
39 01 00 00 00 00 0B B2 80 50 09 03 54 38 11 64 55 09
39 01 00 00 00 00 0C B4 18 6E 18 6E 00 00 10 74 10 74 90
39 01 00 00 00 00 24 D3 00 00 00 01 02 08 00 32 10 00 00 00 00 00 00 00 00 00 00 00 37 33 04 04 37 06 06 37 09 08 00 00 0A 00 01
39 01 00 00 00 00 27 D5 19 19 18 18 19 19 18 18 18 18 03 02 18 18 01 00 18 18 07 06 18 18 05 04 21 20 23 22 18 18 18 18 18 18 18 18 18 18
39 01 00 00 00 00 27 D6 18 18 19 19 19 19 18 18 18 18 04 05 18 18 06 07 18 18 00 01 18 18 02 03 22 23 20 21 18 18 18 18 18 18 18 18 18 18
39 01 00 00 00 00 02 B6 79
39 01 00 00 00 00 2B E0 00 02 04 30 3A 3F 10 37 06 0A 0C 17 0D 10 12 10 12 08 13 18 19 00 02 04 30 3A 3F 10 37 06 0A 0C 17 0D 10 12 10 12 08 13 18 19
39 01 00 00 00 00 02 BD 00
39 01 00 00 00 00 2C C1 01 00 07 13 1A 23 2B 32 3B 43 4A 52 59 60 68 70 78 7F 87 90 98 9F A7 AF B7 BF C7 CF D8 E0 E8 EF F7 FF 29 09 52 5A F0 94 09 5A C0
39 01 00 00 00 00 02 BD 01
39 01 00 00 00 00 2B C1 00 07 11 19 20 28 2F 36 3E 45 4C 53 5A 60 67 6F 77 7E 85 8C 94 9B A2 A9 B0 B8 BF C7 CF D7 DE E5 EB 0C C7 F6 3E 4B 22 95 04 C0
39 01 00 00 00 00 02 BD 02
39 01 00 00 00 00 2B C1 00 07 12 19 21 29 30 38 40 47 4E 55 5C 62 6A 72 7A 82 88 90 98 9F A6 AE B4 BC C5 CD D5 DC E3 EA F2 16 85 52 7F 1E 09 F1 5B 80
39 01 00 00 00 00 05 C7 00 80 00 C0
39 01 00 00 00 00 05 C0 30 15 00 03
39 01 00 00 00 00 02 D2 22
39 01 00 00 00 00 02 CC 02
39 01 00 00 00 00 02 35 00
39 01 00 00 00 00 02 51 FF
39 01 00 00 00 00 02 53 24
39 01 00 00 05 00 02 55 13
39 01 00 00 01 00 07 C9 1F 00 04 1E 80 1E
39 01 00 00 96 00 02 11 00
39 01 00 00 01 00 03 E4 42 00
39 01 00 00 14 00 12 E6 DC 00 00 05 05 20 20 10 20 20 20 10 05 05 06 09 20
39 01 00 00 14 00 02 29 00];
		qcom,mdss-dsi-off-command = [05 01 00 00 32 00 02 28 00
					05 01 00 00 78 00 02 10 00];
		qcom,mdss-dsi-on-command-state = "dsi_lp_mode";
		qcom,mdss-dsi-off-command-state = "dsi_hs_mode";
		qcom,mdss-dsi-panel-status-command = [06 01 00 01 05 00 02 0A 08];
		qcom,mdss-dsi-panel-status-command-state = "dsi_lp_mode";
		//huqiao modify for do not use 15095 reg_read esd mode
		//qcom,mdss-dsi-panel-status-check-mode = "reg_read";
		qcom,mdss-dsi-panel-status-value = <0x1C>;
		qcom,mdss-dsi-h-sync-pulse = <1>;
		qcom,mdss-dsi-traffic-mode = "burst_mode";
		qcom,mdss-dsi-lane-map = <0>;
		qcom,mdss-dsi-bllp-eof-power-mode;
		qcom,mdss-dsi-bllp-power-mode;
		qcom,mdss-dsi-lane-0-state;
		qcom,mdss-dsi-lane-1-state;
		/*qcom,mdss-dsi-tx-eot-append;*/
		qcom,mdss-dsi-lp11-init;
		qcom,mdss-dsi-init-delay-us=<50000>;
		qcom,mdss-dsi-panel-timings = [87 1C 12 00 42 44 18 20 17 03 04 00];
		qcom,mdss-dsi-t-clk-post = <0x04>;
		qcom,mdss-dsi-t-clk-pre = <0x1B>;
		qcom,mdss-dsi-bl-min-level = <1>;
		qcom,mdss-dsi-bl-max-level = <255>;
		qcom,mdss-dsi-dma-trigger = "trigger_sw";
		qcom,mdss-dsi-mdp-trigger = <0>;
		qcom,mdss-dsi-bl-pmic-control-type = "bl_ctrl_wled";
		qcom,mdss-dsi-reset-sequence = <1 20>, <0 20>, <1 20>;
		qcom,mdss-pan-physical-width-dimension = <62>;
		qcom,mdss-pan-physical-height-dimension = <110>;
		qcom,mdss-dsi-cabc-off-command = [15 01 00 00 10 00 02 55 10
										05 01 00 00 10 00 02 29 00];
		qcom,mdss-dsi-cabc-ui-command = [15 01 00 00 10 00 02 55 11
										05 01 00 00 10 00 02 29 00];
		qcom,mdss-dsi-cabc-still-image-command = [15 01 00 00 10 00 02 55 12
												  05 01 00 00 10 00 02 29 00];
		qcom,mdss-dsi-cabc-video-command = [15 01 00 00 10 00 02 55 13
										    05 01 00 00 10 00 02 29 00];
	};
};
