/* Copyright (c) 2013, The Linux Foundation. All rights reserved.
 *
 * This program is free software; you can redistribute it and/or modify
 * it under the terms of the GNU General Public License version 2 and
 * only version 2 as published by the Free Software Foundation.
 *
 * This program is distributed in the hope that it will be useful,
 * but WITHOUT ANY WARRANTY; without even the implied warranty of
 * MERCHANTABILITY or FITNESS FOR A PARTICULAR PURPOSE.  See the
 * GNU General Public License for more details.
 */

/*---------------------------------------------------------------------------
 * This file is autogenerated file using gcdb parser. Please do not edit it.
 * Update input XML file to add a new entry or update variable in this file
 * VERSION = "1.0"
 *---------------------------------------------------------------------------*/
&mdss_mdp {
	dsi_oppo15399tm_nt35521s_720p_video: qcom,mdss_dsi_oppo15399tm_nt35521s_720p_video {
		qcom,mdss-dsi-panel-name = "oppo15399tm nt35521s 720p video mode dsi panel";
		qcom,mdss-dsi-panel-manufacture = "TM_0420";
		qcom,mdss-dsi-panel-version = "NT35521S";		
		qcom,mdss-dsi-panel-controller = <&mdss_dsi0>;
		qcom,mdss-dsi-panel-type = "dsi_video_mode";
		qcom,mdss-dsi-panel-destination = "display_1";
		qcom,mdss-dsi-panel-framerate = <60>;
		qcom,mdss-dsi-virtual-channel-id = <0>;
		qcom,mdss-dsi-stream = <0>;
		qcom,mdss-dsi-panel-width = <720>;
		qcom,mdss-dsi-panel-height = <1280>;
		qcom,mdss-dsi-h-front-porch = <240>;
		qcom,mdss-dsi-h-back-porch = <230>;
		qcom,mdss-dsi-h-pulse-width = <8>;
		qcom,mdss-dsi-h-sync-skew = <0>;
		qcom,mdss-dsi-v-back-porch = <26>;
		qcom,mdss-dsi-v-front-porch = <26>;
		qcom,mdss-dsi-v-pulse-width = <8>;
		qcom,mdss-dsi-h-left-border = <0>;
		qcom,mdss-dsi-h-right-border = <0>;
		qcom,mdss-dsi-v-top-border = <0>;
		qcom,mdss-dsi-v-bottom-border = <0>;
		qcom,mdss-dsi-bpp = <24>;
		qcom,mdss-dsi-color-order = "rgb_swap_rgb";
		qcom,mdss-dsi-underflow-color = <0xff>;
		qcom,mdss-dsi-border-color = <0>;
		qcom,mdss-dsi-pixel-packing = "tight";
		qcom,mdss-dsi-on-command = [39 01 00 00 00 00 05 FF AA 55 25 01
39 01 00 00 00 00 02 6F 16
39 01 00 00 00 00 02 F7 10
39 01 00 00 00 00 05 FF AA 55 25 00
39 01 00 00 00 00 06 F0 55 AA 52 08 00
39 01 00 00 00 00 02 6F 02
39 01 00 00 00 00 02 B8 01
39 01 00 00 00 00 02 EC 05
39 01 00 00 00 00 03 BB AA AA
39 01 00 00 00 00 03 BC 00 00
39 01 00 00 00 00 02 C8 80
39 01 00 00 00 00 02 B6 06
39 01 00 00 00 00 06 F0 55 AA 52 08 01
39 01 00 00 00 00 03 B0 0F 0F
39 01 00 00 00 00 03 B1 0F 0F
39 01 00 00 00 00 03 BC 78 00
39 01 00 00 00 00 03 BD 78 00
39 01 00 00 00 00 02 CA 00
39 01 00 00 00 00 02 C0 04
39 01 00 00 00 00 03 B5 03 03
39 01 00 00 00 00 03 B3 1E 1E
39 01 00 00 00 00 03 B4 0F 0F
39 01 00 00 00 00 03 B9 34 34
39 01 00 00 00 00 03 BA 15 15
39 01 00 00 00 00 06 F0 55 AA 52 08 02
39 01 00 00 00 00 02 EE 03
39 01 00 00 00 00 11 B0 00 00 00 16 00 3A 00 56 00 6D 00 94 00 B3 00 E6
39 01 00 00 00 00 11 B1 01 0F 01 4F 01 82 01 D5 02 1A 02 1C 02 5D 02 A2
39 01 00 00 00 00 11 B2 02 CB 03 00 03 22 03 50 03 6D 03 92 03 AB 03 C1
39 01 00 00 00 00 05 B3 03 D1 03 D3
39 01 00 00 00 00 11 B4 00 9F 00 A7 00 B5 00 C2 00 CE 00 E4 00 F9 01 22
39 01 00 00 00 00 11 B5 01 42 01 72 01 9D 01 E9 02 26 02 28 02 65 02 A8
39 01 00 00 00 00 11 B6 02 D0 03 03 03 26 03 50 03 6D 03 91 03 A8 03 BF
39 01 00 00 00 00 05 B7 03 D0 03 D3
39 01 00 00 00 00 11 B8 00 5C 00 66 00 78 00 88 00 97 00 B2 00 CB 00 FB
39 01 00 00 00 00 11 B9 01 20 01 57 01 87 01 DB 02 1C 02 1E 02 5E 02 A4
39 01 00 00 00 00 11 BA 02 CD 03 01 03 26 03 5A 03 83 03 A9 03 B0 03 BF
39 01 00 00 00 00 05 BB 03 D1 03 D3
39 01 00 00 00 00 06 F0 55 AA 52 08 06
39 01 00 00 00 00 03 B0 08 34
39 01 00 00 00 00 03 B1 31 34
39 01 00 00 00 00 03 B2 34 2E
39 01 00 00 00 00 03 B3 2D 34
39 01 00 00 00 00 03 B4 00 02
39 01 00 00 00 00 03 B5 34 12
39 01 00 00 00 00 03 B6 10 34
39 01 00 00 00 00 03 B7 34 18
39 01 00 00 00 00 03 B8 16 34
39 01 00 00 00 00 03 B9 34 34
39 01 00 00 00 00 03 BA 34 34
39 01 00 00 00 00 03 BB 34 17
39 01 00 00 00 00 03 BC 19 34
39 01 00 00 00 00 03 BD 34 11
39 01 00 00 00 00 03 BE 13 34
39 01 00 00 00 00 03 BF 03 01
39 01 00 00 00 00 03 C0 34 2D
39 01 00 00 00 00 03 C1 2E 34
39 01 00 00 00 00 03 C2 34 31
39 01 00 00 00 00 03 C3 34 09
39 01 00 00 00 00 03 E5 34 34
39 01 00 00 00 00 03 C4 09 34
39 01 00 00 00 00 03 C5 31 34
39 01 00 00 00 00 03 C6 34 2D
39 01 00 00 00 00 03 C7 2E 34
39 01 00 00 00 00 03 C8 03 01
39 01 00 00 00 00 03 C9 34 17
39 01 00 00 00 00 03 CA 19 34
39 01 00 00 00 00 03 CB 34 11
39 01 00 00 00 00 03 CC 13 34
39 01 00 00 00 00 03 CD 34 34
39 01 00 00 00 00 03 CE 34 34
39 01 00 00 00 00 03 CF 34 12
39 01 00 00 00 00 03 D0 10 34
39 01 00 00 00 00 03 D1 34 18
39 01 00 00 00 00 03 D2 16 34
39 01 00 00 00 00 03 D3 00 02
39 01 00 00 00 00 03 D4 34 2E
39 01 00 00 00 00 03 D5 2D 34
39 01 00 00 00 00 03 D6 34 31
39 01 00 00 00 00 03 D7 34 08
39 01 00 00 00 00 03 E6 34 34
39 01 00 00 00 00 06 D8 00 00 00 00 00
39 01 00 00 00 00 06 D9 00 00 00 00 00
39 01 00 00 00 00 02 E7 00
39 01 00 00 00 00 06 F0 55 AA 52 08 05
39 01 00 00 00 00 02 ED 30
39 01 00 00 00 00 06 F0 55 AA 52 08 03
39 01 00 00 00 00 03 B1 20 00
39 01 00 00 00 00 03 B0 20 00
39 01 00 00 00 00 06 F0 55 AA 52 08 05
39 01 00 00 00 00 02 E5 00
39 01 00 00 00 00 06 F0 55 AA 52 08 05
39 01 00 00 00 00 03 B0 17 06
39 01 00 00 00 00 02 B8 00
39 01 00 00 00 00 06 BD 03 03 01 00 03
39 01 00 00 00 00 03 B1 17 06
39 01 00 00 00 00 03 B9 00 03
39 01 00 00 00 00 03 B2 17 06
39 01 00 00 00 00 03 BA 00 00
39 01 00 00 00 00 03 B3 17 06
39 01 00 00 00 00 03 BB 00 00
39 01 00 00 00 00 03 B4 17 06
39 01 00 00 00 00 03 B5 17 06
39 01 00 00 00 00 03 B6 17 06
39 01 00 00 00 00 03 B7 17 06
39 01 00 00 00 00 03 BC 00 03
39 01 00 00 00 00 02 E5 06
39 01 00 00 00 00 02 E6 06
39 01 00 00 00 00 02 E7 06
39 01 00 00 00 00 02 E8 06
39 01 00 00 00 00 02 E9 06
39 01 00 00 00 00 02 EA 06
39 01 00 00 00 00 02 EB 06
39 01 00 00 00 00 02 EC 06
39 01 00 00 00 00 06 F0 55 AA 52 08 05
39 01 00 00 00 00 02 C0 0B
39 01 00 00 00 00 02 C1 09
39 01 00 00 00 00 02 C2 0B
39 01 00 00 00 00 02 C3 09
39 01 00 00 00 00 06 F0 55 AA 52 08 03
39 01 00 00 00 00 06 B2 05 00 00 00 00
39 01 00 00 00 00 06 B3 05 00 00 00 00
39 01 00 00 00 00 06 B4 05 00 00 00 00
39 01 00 00 00 00 06 B5 05 00 00 00 00
39 01 00 00 00 00 06 F0 55 AA 52 08 05
39 01 00 00 00 00 02 C4 0F
39 01 00 00 00 00 02 C5 0F
39 01 00 00 00 00 02 C6 0F
39 01 00 00 00 00 02 C7 0F
39 01 00 00 00 00 06 F0 55 AA 52 08 03
39 01 00 00 00 00 06 B6 05 00 00 00 00
39 01 00 00 00 00 06 B7 05 00 00 00 00
39 01 00 00 00 00 06 B8 05 00 00 00 00
39 01 00 00 00 00 06 B9 05 00 00 00 00
39 01 00 00 00 00 06 F0 55 AA 52 08 05
39 01 00 00 00 00 03 C8 07 20
39 01 00 00 00 00 03 C9 03 20
39 01 00 00 00 00 03 CA 07 00
39 01 00 00 00 00 03 CB 03 00
39 01 00 00 00 00 06 F0 55 AA 52 08 03
39 01 00 00 00 00 06 BA 53 00 00 00 00
39 01 00 00 00 00 06 BB 53 00 00 00 00
39 01 00 00 00 00 06 BC 53 00 00 00 00
39 01 00 00 00 00 06 BD 53 00 00 00 00
39 01 00 00 00 00 06 F0 55 AA 52 08 05
39 01 00 00 00 00 06 D1 00 05 00 07 10
39 01 00 00 00 00 06 D2 00 05 04 07 10
39 01 00 00 00 00 06 D3 00 00 0A 07 10
39 01 00 00 00 00 06 D4 00 00 0A 07 10
39 01 00 00 00 00 06 F0 55 AA 52 08 05
39 01 00 00 00 00 08 D0 00 00 00 00 00 00 00
39 01 00 00 00 00 0C D5 00 00 00 00 00 00 00 00 00 00 00
39 01 00 00 00 00 0C D6 00 00 00 00 00 00 00 00 00 00 00
39 01 00 00 00 00 0C D7 00 00 00 00 00 00 00 00 00 00 00
39 01 00 00 00 00 06 D8 00 00 00 00 00
39 01 00 00 00 00 06 F0 55 AA 52 08 03
39 01 00 00 00 00 02 C4 60
39 01 00 00 00 00 02 C5 40
39 01 00 00 00 00 02 C6 60
39 01 00 00 00 00 02 C7 40
39 01 00 00 00 00 02 6F 01
39 01 00 00 00 00 02 F9 46
39 01 00 00 00 00 06 F0 55 AA 52 08 04
39 01 00 00 00 00 02 C3 83
39 01 00 00 00 00 06 F0 55 AA 52 08 00
39 01 00 00 00 00 02 C8 80
39 01 00 00 00 00 04 D9 01 01 4D
39 01 00 00 00 00 02 51 FF
39 01 00 00 00 00 02 53 24
39 01 00 00 00 00 02 55 81
39 01 00 00 00 00 06 F0 55 AA 52 08 00
39 01 00 00 00 00 07 CC 40 36 87 00 00 00
39 01 00 00 00 00 0D CE 10 10 10 10 10 10 10 10 10 10 10 10
39 01 00 00 00 00 11 D1 00 02 03 04 06 08 0a 0C 0E 0E 0C 0A 08 04 02 00
05 01 00 00 78 00 02 11 00
05 01 00 00 14 00 02 29 00];
		qcom,mdss-dsi-off-command = [05 01 00 00 32 00 02 28 00
					05 01 00 00 78 00 02 10 00];
		qcom,mdss-dsi-on-command-state = "dsi_lp_mode";
		qcom,mdss-dsi-off-command-state = "dsi_hs_mode";
		qcom,mdss-dsi-cabc-off-command = [15 01 00 00 10 00 02 55 00
										  05 01 00 00 10 00 02 29 00];
		qcom,mdss-dsi-cabc-ui-command = [15 01 00 00 10 00 02 55 01
										 05 01 00 00 10 00 02 29 00];
		qcom,mdss-dsi-cabc-still-image-command = [15 01 00 00 10 00 02 55 02
												  05 01 00 00 10 00 02 29 00];
		qcom,mdss-dsi-cabc-video-command = [15 01 00 00 10 00 02 55 03
											05 01 00 00 10 00 02 29 00];
		qcom,mdss-dsi-panel-status-command = [06 01 00 01 05 00 02 0A 08];
		qcom,mdss-dsi-panel-status-command-state = "dsi_lp_mode";
		qcom,mdss-dsi-panel-status-check-mode = "reg_read";
		qcom,mdss-dsi-panel-status-value = <0x9C>;
		qcom,mdss-dsi-tx-eot-append;		
		qcom,mdss-dsi-h-sync-pulse = <1>;
		qcom,mdss-dsi-lp11-init;
		qcom,mdss-dsi-init-delay-us = <50000>;		
		qcom,mdss-dsi-traffic-mode = "burst_mode";
		qcom,mdss-dsi-lane-map = "lane_map_0123";
		qcom,mdss-dsi-bllp-eof-power-mode;
		qcom,mdss-dsi-bllp-power-mode;
		qcom,mdss-dsi-hfp-power-mode;
		qcom,mdss-dsi-hbp-power-mode;
		qcom,mdss-dsi-hsa-power-mode;
		qcom,mdss-dsi-lane-0-state;
		qcom,mdss-dsi-lane-1-state;
		qcom,mdss-dsi-lane-2-state;
		//qcom,mdss-dsi-lane-3-state;
		qcom,mdss-dsi-panel-timings = [E2 30 20 00 5C 62 24 34 26 03 04 00];
		qcom,mdss-dsi-t-clk-post = <0x04>;
		qcom,mdss-dsi-t-clk-pre = <0x29>;
		qcom,mdss-dsi-bl-min-level = <16>;
		qcom,mdss-dsi-bl-max-level = <240>;
		qcom,mdss-dsi-dma-trigger = "trigger_sw";
		qcom,mdss-dsi-mdp-trigger = <0>;
		qcom,mdss-dsi-bl-pmic-control-type = "bl_ctrl_wled";
		qcom,mdss-dsi-reset-sequence = <1 10>, <0 1>, <1 15>;
		qcom,mdss-pan-physical-width-dimension = <62>;
		qcom,mdss-pan-physical-height-dimension = <110>;
	};
};
